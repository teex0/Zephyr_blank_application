## build/Kconfig/arch/Kconfig.tmp
```kconfig
# Load Zephyr Arch Kconfig descriptions.
osource "/home/fae/zephyrproject/zephyr/arch/rx/Kconfig"
osource "/home/fae/zephyrproject/zephyr/arch/x86/Kconfig"
osource "/home/fae/zephyrproject/zephyr/arch/xtensa/Kconfig"
osource "/home/fae/zephyrproject/zephyr/arch/sparc/Kconfig"
osource "/home/fae/zephyrproject/zephyr/arch/riscv/Kconfig"
osource "/home/fae/zephyrproject/zephyr/arch/posix/Kconfig"
osource "/home/fae/zephyrproject/zephyr/arch/openrisc/Kconfig"
osource "/home/fae/zephyrproject/zephyr/arch/mips/Kconfig"
osource "/home/fae/zephyrproject/zephyr/arch/arm64/Kconfig"
osource "/home/fae/zephyrproject/zephyr/arch/arm/Kconfig"
osource "/home/fae/zephyrproject/zephyr/arch/arc/Kconfig"
```

## build/Kconfig/boards/Kconfig.b_u585i_iot02a.tmp
```kconfig
# Load board Kconfig descriptions.
osource "/home/fae/zephyrproject/zephyr/boards/st/b_u585i_iot02a/Kconfig.b_u585i_iot02a"
```

## build/Kconfig/boards/Kconfig.defconfig
```kconfig
# Load Zephyr board defconfig descriptions.
osource "/home/fae/zephyrproject/zephyr/boards/st/b_u585i_iot02a/Kconfig.defconfig"
```
